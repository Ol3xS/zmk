## app/boards/shields/place_hd/Kconfig.defconfig
```kconfig
if SHIELD_PLACE_HD_LEFT

config ZMK_KEYBOARD_NAME
	default "Place_HD"

config ZMK_SPLIT_ROLE_CENTRAL
	default y

endif

if SHIELD_PLACE_HD_LEFT || SHIELD_PLACE_HD_RIGHT

config ZMK_SPLIT
	default y

endif
```

## app/boards/shields/place_hd/Kconfig.shield
```kconfig
# Copyright (c) 2020 Pete Johanson
# SPDX-License-Identifier: MIT


config SHIELD_PLACE_HD_LEFT
	def_bool $(shields_list_contains,place_hd_left)
	select SHIELD_PLACE_HD

config SHIELD_PLACE_HD_RIGHT
	def_bool $(shields_list_contains,place_hd_right)
	select SHIELD_PLACE_HD
```
