/*
 * Copyright (c) 2020 Pete Johanson
 *
 * SPDX-License-Identifier: MIT
 */

#include "place_hd.dtsi"

&kscan0 {
	col-gpios
		= <&pro_micro 16 GPIO_ACTIVE_HIGH>
		, <&pro_micro 10 GPIO_ACTIVE_HIGH>
		, <&gpio1 7 GPIO_ACTIVE_HIGH>
		, <&gpio1 2 GPIO_ACTIVE_HIGH>
		, <&gpio1 1 GPIO_ACTIVE_HIGH>
		;
};

&left_encoder {
	status = "okay";
};
