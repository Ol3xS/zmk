/*
 * Copyright (c) 2020 Pete Johanson
 *
 * SPDX-License-Identifier: MIT
 */

#include "place_hd.dtsi"

&default_transform {
	col-offset = <5>;
};

&kscan0 {
	col-gpios
		= <&gpio1 1 GPIO_ACTIVE_HIGH>
		, <&gpio1 2 GPIO_ACTIVE_HIGH>
		, <&gpio1 7 GPIO_ACTIVE_HIGH>
		, <&pro_micro 10 GPIO_ACTIVE_HIGH>
		, <&pro_micro 16 GPIO_ACTIVE_HIGH>
		;
};

&right_encoder {
	status = "okay";
};